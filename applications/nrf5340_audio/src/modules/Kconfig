## applications/nrf5340_audio/src/modules/Kconfig
```kconfig
#
# Copyright (c) 2022 Nordic Semiconductor ASA
#
# SPDX-License-Identifier: LicenseRef-Nordic-5-Clause
#

rsource "Kconfig.defaults"

menu "Modules"

config BUTTON_DEBOUNCE_MS
	int "Button debounce time in ms"
	default 50

#----------------------------------------------------------------------------#
menu "Power measurement"

config POWER_MODULE_MIN_MEAS_TIME_MS
	int "Power measurement interval in milliseconds"
	default 200

config POWER_MODULE_MEAS_START_ON_BOOT
	bool "Start power measurements for all rails on boot"
	default n
	help
		This option will automatically start and periodically print
		the voltage, current consumption, and power usage for the
		following rails: VBAT, VDD1_CODEC, VDD2_CODEC, and VDD2_NRF

endmenu # Power measurement

#----------------------------------------------------------------------------#
menu "I2S"

config I2S_LRCK_FREQ_HZ
	int
	default AUDIO_SAMPLE_RATE_HZ
	help
	 The sample rate of I2S. For now this is tied directly to
	 AUDIO_SAMPLE_RATE_HZ
	 Note that this setting is only valid in I2S master mode.

config I2S_CH_NUM
	int
	default 2
	help
	 The I2S driver itself supports both mono and stereo.
	 Parts of the implementation are configured for only stereo.

endmenu # I2S

#----------------------------------------------------------------------------#
menu "Music Color Synchronization"

config MUSIC_COLOR_SYNC
	bool "Enabling RGB synchronization with music"
	default n

menu "FFT"
visible if MUSIC_COLOR_SYNC

config FFT_SAMPLE_SIZE
	int "Sample size for FFT"
	default 256
	help
		 Supported FFT Lengths are 32, 64, 128, 256, 512,
		 1024, 2048, 4096 and 8192.

config FFT_FLAG_INVERSE_TRANSFORM
	int "Flag for transform direction"
	range 0 1
	default 0
	help
		0 for FFT and 1 for IFFT

config FFT_FLAG_BIT_REVERSAL
	int "Flag for bit reversal of output"
	range 0 1
	default 1
	help
		0 to disable and 1 to enable bitreversal 

endmenu # Music sync
endmenu # RGB Music Sync

#----------------------------------------------------------------------------#
menu "Log levels"

config LOG_I2S_LEVEL
	int "Log level for audio_i2s"
	default 2

config LOG_LED_LEVEL
	int "Log level for LED"
	default 2

config LOG_AUDIO_USB_LEVEL
	int "Log level for USB audio"
	default 2

config LOG_POWER_MODULE_LEVEL
	int "Log level for power module"
	default 3

config LOG_PMIC_LEVEL
	int "Log level for PMIC"
	default 2

config LOG_HW_CODEC_LEVEL
	int "Log level for HW_CODEC"
	default 2

config LOG_BUTTON_HANDLER_LEVEL
	int "Log level for button_handler.c"
	default 2

config LOG_SD_CARD_LEVEL
	int "Log level for SD card"
	default 2

config LOG_MUSIC_COLOR_SYNC_LEVEL
	int "Log level for music_color_sync"
	default 3

endmenu # Log levels

#----------------------------------------------------------------------------#
menu "Thread priorities"

config POWER_MODULE_THREAD_PRIO
	int "Priority for power measurement thread"
	default 6
	help
		This is a preemptible thread

config MUSIC_COLOR_SYNC_THREAD_PRIO
	int "Priority for music color sync thread"
	default 6

endmenu # Thread priorities

#----------------------------------------------------------------------------#
menu "Stack sizes"

config POWER_MODULE_STACK_SIZE
	int "Stack size for power module"
	default 1152

config MUSIC_COLOR_SYNC_STACK_SIZE
	int "Stack size for music color sync module"
	default 40000

endmenu # Stack sizes
endmenu # Modules
```
